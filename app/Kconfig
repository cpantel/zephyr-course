## app/Kconfig
```kconfig
menu "Local configuration"
  config APP_HEARTBEAT_PERIOD_MS
  int "Heartbeat period"
  range 100 2000
  default 500

endmenu


menu "Zephyr configuration"
  source "Kconfig.zephyr"
endmenu
```

## app/boards/charlie/nxp/mimxrt1020_evk/Kconfig.my_mimxrt1020_evk
```kconfig
# Copyright (c) 2018, NXP
# SPDX-License-Identifier: Apache-2.0

config BOARD_MY_MIMXRT1020_EVK
	select SOC_PART_NUMBER_MIMXRT1021DAG5A
```

## app/boards/charlie/nxp/mimxrt1020_evk/board.yml
```yaml
board:
  name: my_mimxrt1020_evk
  full_name: MY MIMXRT1020-EVK
  vendor: charlie
  socs:
    - name: mimxrt1021
```

## app/boards/charlie/st/my_nucleo_f429zi/board.yml
```yaml
board:
  name: my_nucleo_f429zi
  full_name: My Nucleo F429ZI
  vendor: charlie
  socs:
    - name: stm32f429xx
```

## app/boards/charlie/st/my_nucleo_l4a6zg/Kconfig.my_nucleo_l4a6zg
```kconfig
# Copyright (c) 2022 Tomislav Milkovic
# SPDX-License-Identifier: Apache-2.0

config BOARD_MY_NUCLEO_L4A6ZG
	select SOC_STM32L4A6XX
```

## app/boards/charlie/st/my_nucleo_l4a6zg/board.yml
```yaml
board:
  name: my_nucleo_l4a6zg
  full_name: My Nucleo L4A6ZG
  vendor: charlie
  socs:
    - name: stm32l4a6xx
```

## app/boards/st/my_nucleo_f429zi/Kconfig.my_nucleo_f429zi
```kconfig
# Copyright (c) 2017 Linaro Limited
# SPDX-License-Identifier: Apache-2.0

config BOARD_MY_NUCLEO_F429ZI
	select SOC_STM32F429XX
```

## app/boards/st/nucleo_l4a6zg_blue/board.yml
```yaml
board:
  name: nucleo_l4a6zg_blue
  full_name: Nucleo L4A6ZG Blue
  vendor: st
  socs:
    - name: stm32l4a6xx
```
